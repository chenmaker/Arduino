#include <SPI.h>
#include <Wire.h>
#include <Adafruit_GFX.h>
#include <Adafruit_SSD1306.h>
#include <Arduino.h>
#include <DS3231.h>
DS3231  rtc(SDA, SCL);
String any;

#include <dht.h>   
#define dht_dpin 8 //定義訊號要從Pin 8 進來  
dht DHT;  
String th;
#define SCREEN_WIDTH 128 // OLED display width, in pixels
#define SCREEN_HEIGHT 64 // OLED display height, in pixels

// Declaration for SSD1306 display connected using software SPI (default case):
#define OLED_MOSI   9//SDA
#define OLED_CLK   10//SCL
#define OLED_DC    11
#define OLED_CS    12//它不用接
#define OLED_RESET 13
Adafruit_SSD1306 display(SCREEN_WIDTH, SCREEN_HEIGHT,
  OLED_MOSI, OLED_CLK, OLED_DC, OLED_RESET, OLED_CS);

#define LOGO_HEIGHT   64
#define LOGO_WIDTH   128
static const unsigned char PROGMEM logo_bmp[] =
{ B00000000,B00000000,B00000000,B00000000,B00000000,B00000000,B00000000,B00000000,B00000000,B00000000,B00000000,B00000000,B00000000,B00000000,B00000000,B00000000,
  B00000000,B00000000,B00000000,B00000000,B00000000,B00000000,B00000000,B00000000,B00000000,B00000000,B00000000,B00000000,B00000000,B00000000,B00000000,B00000000,
  B00000000,B00000000,B00000000,B00000000,B00000000,B11111111,B00000000,B00000000,B00000000,B00000000,B00000000,B00000000,B00000000,B00000000,B00000000,B00000000,
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  B00000000,B00000000,B00000000,B00000000,B00000000,B00000000,B00000000,B00000000,B00000000,B00000000,B00000000,B00000000,B00000000,B00000000,B00000000,B00000000
 };
#include <Bounce.h>
const int bt1 =2;
const int bt2 =4;
const int led = 7;
Bounce  bts1=Bounce(2, 50);
Bounce  bts2=Bounce(4, 50);
int btany=0;
void setup() {
  Serial.begin(9600);
   display.begin(9600);
pinMode(led,OUTPUT);
pinMode(bt1,INPUT);
pinMode(bt2,INPUT);

}

void loop() {
  DHT.read11(dht_dpin);
//bts1=digitalRead(bt1);
//bts2=digitalRead(bt2);
if(bts1.update() == true && bts1.read() == HIGH){
  btany+=1;
  //delay(100);
  }
if(bts2.update() == true && bts2.read() == HIGH){
  btany-=1;
 // delay(100);
  }
  if(btany<0 ){
    btany=2;
  }else if(btany>2){
    btany=0;
    }
switch (btany) {
  case 0:
  digitalWrite(led,LOW);
  display.clearDisplay();
  display.setTextSize(2);             // Normal 1:1 pixel scale
  display.setTextColor(WHITE);        // Draw white text
  display.setCursor(30,20);             // Start at top-left corner
  display.println("Hello");
  display.display();
    break;
  case 1:
  digitalWrite(led,HIGH);
  display.clearDisplay();
  display.drawBitmap(0,0, logo_bmp, SCREEN_WIDTH, SCREEN_HEIGHT, WHITE);
  display.display();
    break;
  case 2:
digitalWrite(led,LOW);
  display.clearDisplay();
  //th=("H:"+String(DHT.humidity)+"  C:"+String(DHT.temperature)); 
  DHT.read11(dht_dpin);
  Serial.println(th);
  display.setTextSize(2);             // Normal 1:1 pixel scale
  display.setTextColor(WHITE);        // Draw white text
  display.setCursor(20,20);             // Start at top-left corner
  //display.println(th);
  display.println("H:"+String(DHT.humidity));
   display.setTextSize(2);             // Normal 1:1 pixel scale
  display.setTextColor(WHITE);        // Draw white text
  display.setCursor(20,40);             // Start at top-left corner  
  display.println("C:"+String(DHT.temperature));
  display.display();
  //delay(1000);
    break;
    }
  Serial.println(btany);
}
